## firmware/matter/main/Kconfig.projbuild
```kconfig
menu "Switch Robot"

    choice SWROBOT_MODE
        prompt "Actuator mode"
        default SWROBOT_MODE_SERVO
        help
            SERVO: self-built robot, a servo with a double press arm rocks the 86 switch.
            PHOTOMOS: retrofit route, U1/U2 PhotoMOS short the ON/OFF buttons of an
            existing remote (J4 = ON button, J5 = OFF button).

        config SWROBOT_MODE_SERVO
            bool "Servo press arm (J3)"
        config SWROBOT_MODE_PHOTOMOS
            bool "PhotoMOS remote buttons (J4/J5)"
    endchoice

    config SWROBOT_SERVO_GPIO
        int "Servo PWM GPIO (J2 pin 2)"
        default 4
        depends on SWROBOT_MODE_SERVO

    config SWROBOT_SERVO_NEUTRAL_US
        int "Servo neutral pulse width (us)"
        default 1500
        range 500 2500
        depends on SWROBOT_MODE_SERVO
        help
            Arm level, both feet clear of the rocker. Calibrate on the real switch.

    config SWROBOT_SERVO_PRESS_DEG
        int "Press angle from neutral (degrees)"
        default 17
        range 1 60
        depends on SWROBOT_MODE_SERVO
        help
            17 deg is the simulated value from V0.6; it is NOT measured on hardware.

    config SWROBOT_SERVO_US_PER_DEG
        int "Pulse width per degree (us, x10)"
        default 111
        depends on SWROBOT_MODE_SERVO
        help
            SG90 class servos are roughly 500-2500 us over 180 deg, i.e. 11.1 us/deg.
            Value is in tenths of a microsecond.

    config SWROBOT_SERVO_INVERT
        bool "Swap ON/OFF press direction"
        default n
        depends on SWROBOT_MODE_SERVO

    config SWROBOT_PRESS_HOLD_MS
        int "Press hold time (ms)"
        default 400
        range 50 3000
        help
            Servo mode: how long the arm stays at the press angle before returning.
            PhotoMOS mode: how long the remote button is held closed.

    config SWROBOT_SERVO_RELEASE_PWM
        bool "Stop PWM after returning to neutral"
        default y
        depends on SWROBOT_MODE_SERVO
        help
            Cuts servo hum and current draw at rest. Needs the return spring
            (see README) so the arm does not drift onto the rocker.

    config SWROBOT_KEY_ON_GPIO
        int "ON button GPIO (J2 pin 3, KEY1 -> U1 -> J4)"
        default 5
        depends on SWROBOT_MODE_PHOTOMOS

    config SWROBOT_KEY_OFF_GPIO
        int "OFF button GPIO (J2 pin 4, KEY2 -> U2 -> J5)"
        default 6
        depends on SWROBOT_MODE_PHOTOMOS

    config SWROBOT_BUTTON_GPIO
        int "Local button GPIO (short press toggles, hold 5 s = factory reset)"
        default 9 if IDF_TARGET_ESP32C3 || IDF_TARGET_ESP32C6 || IDF_TARGET_ESP32H2
        default 0
        help
            Defaults to the BOOT button of common dev boards. Set -1 to disable.

endmenu
```

## firmware/switch_mqtt/main/Kconfig.projbuild
```kconfig
menu "Switch Robot"

    choice SWROBOT_MODE
        prompt "Actuator mode"
        default SWROBOT_MODE_SERVO
        help
            SERVO: self-built robot, a servo with a double press arm rocks the 86 switch (J3).
            PHOTOMOS: retrofit route, U1/U2 PhotoMOS short the ON/OFF buttons of an
            existing remote (J4 = ON button, J5 = OFF button).

        config SWROBOT_MODE_SERVO
            bool "Servo press arm (J3)"
        config SWROBOT_MODE_PHOTOMOS
            bool "PhotoMOS remote buttons (J4/J5)"
    endchoice

    config SWROBOT_SERVO_GPIO
        int "Servo PWM GPIO (V0.5: GPIO4 -> R5 -> J3)"
        default 4

    config SWROBOT_KEY_ON_GPIO
        int "ON button GPIO (V0.5: GPIO5 = KEY1 -> U1 -> J4)"
        default 5

    config SWROBOT_KEY_OFF_GPIO
        int "OFF button GPIO (V0.5: GPIO6 = KEY2 -> U2 -> J5)"
        default 6

    config SWROBOT_BUTTON_GPIO
        int "Local button GPIO (V0.5: GPIO9 = BOOT/SW2). Short press toggles, hold 5 s clears Wi-Fi/MQTT"
        default 9

    config SWROBOT_SERVO_NEUTRAL_US
        int "Default servo neutral pulse (us); changeable later from the hub"
        default 1500
        range 500 2500

    config SWROBOT_SERVO_PRESS_DEG
        int "Default press angle from neutral (deg); simulated value, calibrate on the real switch"
        default 17
        range 1 60

    config SWROBOT_SERVO_US_PER_DEG_X10
        int "Pulse width per degree (tenths of us); SG90 class ~11.1 us/deg"
        default 111

    config SWROBOT_PRESS_HOLD_MS
        int "Default press hold time (ms)"
        default 400
        range 50 3000

    config SWROBOT_SERVO_RELEASE_PWM
        bool "Stop PWM after returning to neutral (needs the return spring)"
        default n
        help
            Cuts servo hum at rest, but without the return spring the arm can drift
            onto the rocker. The spring is not in the CAD yet, so this is off.

endmenu

menu "Home hub defaults"

    config HOME_WIFI_SSID
        string "Wi-Fi SSID baked into the firmware (optional, usually set over USB)"
        default ""

    config HOME_WIFI_PASSWORD
        string "Wi-Fi password baked into the firmware (optional)"
        default ""

    config HOME_MQTT_URI
        string "MQTT broker URI baked into the firmware (optional; empty = ask the LAN)"
        default ""

    config HOME_DISCOVERY_PORT
        int "UDP port the hub answers \"HOMEHUB?\" on"
        default 8781

endmenu
```

## platform/firmware/switch_robot/sdkconfig.defaults
```kconfig
CONFIG_PARTITION_TABLE_CUSTOM=y
CONFIG_PARTITION_TABLE_CUSTOM_FILENAME="partitions.csv"
CONFIG_ESPTOOLPY_FLASHSIZE_4MB=y
CONFIG_FREERTOS_HZ=1000
CONFIG_ESP_BROWNOUT_DET=y
CONFIG_ESP_BROWNOUT_DET_LVL_SEL_0=y
CONFIG_ESP_TASK_WDT_TIMEOUT_S=5
CONFIG_BOOTLOADER_LOG_LEVEL_WARN=y
CONFIG_LOG_DEFAULT_LEVEL_INFO=y
```
